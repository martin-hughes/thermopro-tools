## CMakeLists.txt
```
cmake_minimum_required(VERSION 3.20.0)

if (NOT TEST_NOT_MAIN_BUILD)
    find_package(Zephyr REQUIRED HINTS $ENV{ZEPHYR_BASE})
    project(NONE)

    # NORDIC SDK APP START
    target_sources(app PRIVATE
            src/main.cpp
            src/transceiver.cpp
            src/tp25.cpp
            src/tp25_responses.cpp
    )

    # NORDIC SDK APP END
    zephyr_library_include_directories(.)
else ()
    enable_language(C CXX)
    include(FetchContent)
    FetchContent_Declare(
            googletest
            GIT_REPOSITORY https://github.com/google/googletest.git
            GIT_TAG release-1.12.1
    )

    # For Windows: Prevent overriding the parent project's compiler/linker settings
    set(gtest_force_shared_crt ON CACHE BOOL "" FORCE)
    FetchContent_MakeAvailable(googletest)

    enable_testing()

    add_executable(
            tp25_test

            src/tp25_responses.cpp

            test/main.cpp

            test/responses/temp_report.cpp
            src/bcd.h
    )

    target_link_libraries(
            tp25_test
            GTest::gtest_main
            gmock
    )

    #if (WIN32 AND UT_MEM_LEAK_CHECK)
    #    add_compile_definitions(tmt_test UT_MEM_LEAK_CHECK)
    #endif()

    include(GoogleTest)
    gtest_discover_tests(tp25_test)

endif ()
```

## prj.conf
```kconfig
# Logger module
CONFIG_LOG=y

# Button and LED library
CONFIG_DK_LIBRARY=y

# Bluetooth LE
CONFIG_BT=y
CONFIG_BT_PERIPHERAL=y

# Name this the same as the TP25 so the app can find it
CONFIG_BT_DEVICE_NAME="Thermopro"

# Increase stack size for the main thread and System Workqueue.
# TODO: Some testing to find minimum viable stack size.
CONFIG_SYSTEM_WORKQUEUE_STACK_SIZE=4096
CONFIG_MAIN_STACK_SIZE=4096

# Enable C++ support
CONFIG_CPP=y
CONFIG_STD_CPP20=y

# If CONFIG_STACK_CANARIES is set to y, `bt_gatt_notify` always overflows the stack...
CONFIG_STACK_CANARIES=n
CONFIG_REQUIRES_FULL_LIBCPP=y
# It seems that actually *throwing* an exception always causes a stack fault...
CONFIG_CPP_EXCEPTIONS=n
CONFIG_MINIMAL_LIBCPP=y

# If "minimal libcpp" is no longer enough, delete that line and enable the following:
#CONFIG_GLIBCXX_LIBCPP=y
```

## src/main.c
```c
/*
 * Copyright (c) 2023 Nordic Semiconductor ASA
 *
 * SPDX-License-Identifier: LicenseRef-Nordic-5-Clause
 */

#include <zephyr/kernel.h>
#include <zephyr/logging/log.h>
#include <zephyr/bluetooth/bluetooth.h>
#include <zephyr/bluetooth/gap.h>
#include <zephyr/bluetooth/uuid.h>
#include <zephyr/bluetooth/conn.h>
#include <dk_buttons_and_leds.h>
#include "tp25.h"

static const struct bt_le_adv_param *adv_param = BT_LE_ADV_PARAM(
  (BT_LE_ADV_OPT_CONNECTABLE |
   BT_LE_ADV_OPT_USE_IDENTITY), /* Connectable advertising and use identity address */
  800, /* Min Advertising Interval 500ms (800*0.625ms) */
  801, /* Max Advertising Interval 500.625ms (801*0.625ms) */
  NULL); /* Set to NULL for undirected advertising */

LOG_MODULE_REGISTER(Fake_ThermoPro, LOG_LEVEL_INF);

#define DEVICE_NAME CONFIG_BT_DEVICE_NAME
#define DEVICE_NAME_LEN (sizeof(DEVICE_NAME) - 1)

#define RUN_STATUS_LED DK_LED1
#define CON_STATUS_LED DK_LED2
#define USER_LED DK_LED3
#define USER_BUTTON DK_BTN1_MSK

#define STACKSIZE 1024
#define PRIORITY 7

#define RUN_LED_BLINK_INTERVAL 1000
#define NOTIFY_INTERVAL 500
static bool app_button_state;
static uint32_t app_sensor_value = 100;

static const struct bt_data ad[] = {
  BT_DATA_BYTES(BT_DATA_FLAGS, (BT_LE_AD_GENERAL | BT_LE_AD_NO_BREDR)),
  BT_DATA(BT_DATA_NAME_COMPLETE, DEVICE_NAME, DEVICE_NAME_LEN),

};

static const struct bt_data sd[] = {
  BT_DATA_BYTES(BT_DATA_UUID128_ALL, BT_UUID_LBS_VAL),
};

static void simulate_data(void)
{
  app_sensor_value++;
  if (app_sensor_value == 200) {
    app_sensor_value = 100;
  }
}
static void app_led_cb(bool led_state)
{
  dk_set_led(USER_LED, led_state);
}

static bool app_button_cb(void)
{
  return app_button_state;
}

void send_data_thread(void)
{
  while (1) {
    simulate_data();
    my_lbs_send_sensor_notify(app_sensor_value);

    k_sleep(K_MSEC(NOTIFY_INTERVAL));
  }
}

static struct my_lbs_cb app_callbacks = {
  .led_cb = app_led_cb,
  .button_cb = app_button_cb,
};

static void button_changed(uint32_t button_state, uint32_t has_changed)
{
  if (has_changed & USER_BUTTON) {
    uint32_t user_button_state = button_state & USER_BUTTON;
    /* STEP 6 - Send indication on a button press */
    my_lbs_send_button_state_indicate(user_button_state);
    app_button_state = user_button_state ? true : false;
  }
}
static void on_connected(struct bt_conn *conn, uint8_t err)
{
  if (err) {
    printk("Connection failed (err %u)\n", err);
    return;
  }

  printk("Connected\n");

  dk_set_led_on(CON_STATUS_LED);
}

static void on_disconnected(struct bt_conn *conn, uint8_t reason)
{
  printk("Disconnected (reason %u)\n", reason);

  dk_set_led_off(CON_STATUS_LED);
}

struct bt_conn_cb connection_callbacks = {
  .connected = on_connected,
  .disconnected = on_disconnected,
};

static int init_button(void)
{
  int err;

  err = dk_buttons_init(button_changed);
  if (err) {
    printk("Cannot init buttons (err: %d)\n", err);
  }

  return err;
}

int main(void)
{
  int blink_status = 0;
  int err;

  LOG_INF("Starting Fake ThermoPro TP25\n");

  err = dk_leds_init();
  if (err) {
    LOG_ERR("LEDs init failed (err %d)\n", err);
    return -1;
  }

  err = init_button();
  if (err) {
    printk("Button init failed (err %d)\n", err);
    return -1;
  }

  err = bt_enable(NULL);
  if (err) {
    LOG_ERR("Bluetooth init failed (err %d)\n", err);
    return -1;
  }
  bt_conn_cb_register(&connection_callbacks);

  err = my_lbs_init(&app_callbacks);
  if (err) {
    printk("Failed to init LBS (err:%d)\n", err);
    return -1;
  }

  LOG_INF("Bluetooth initialized\n");

  err = bt_le_adv_start(adv_param, ad, ARRAY_SIZE(ad), sd, ARRAY_SIZE(sd));
  if (err) {
    LOG_ERR("Advertising failed to start (err %d)\n", err);
    return -1;
  }

  LOG_INF("Advertising successfully started\n");
  for (;;) {
    dk_set_led(RUN_STATUS_LED, (++blink_status) % 2);
    k_sleep(K_MSEC(RUN_LED_BLINK_INTERVAL));
  }
}

/* STEP 18.2 - Define and initialize a thread to send data periodically */
K_THREAD_DEFINE(send_data_thread_id, STACKSIZE, send_data_thread, NULL, NULL, NULL, PRIORITY, 0, 0);
```

## src/main.cpp
```c
#include <zephyr/kernel.h>
#include <zephyr/logging/log.h>
#include <zephyr/bluetooth/bluetooth.h>
#include <zephyr/bluetooth/gap.h>
#include <zephyr/bluetooth/uuid.h>
#include <zephyr/bluetooth/conn.h>
#include <dk_buttons_and_leds.h>

#include "transceiver.h"
#include "tp25.h"

LOG_MODULE_REGISTER(Fake_ThermoPro, LOG_LEVEL_INF);

namespace {
  //
  // Helper functions
  //
  void tp25_notify_request(RawNotification response);
  void tp25_command_write(const uint8_t *buffer, uint8_t length);

  void on_connected(bt_conn *conn, uint8_t err);
  void on_disconnected(bt_conn *conn, uint8_t reason);

  //
  // Application specific data.
  //
  const bt_le_adv_param *adv_param = BT_LE_ADV_PARAM(
    (BT_LE_ADV_OPT_CONNECTABLE |
      BT_LE_ADV_OPT_USE_IDENTITY), /* Connectable advertising and use identity address */
    800, /* Min Advertising Interval 500ms (800*0.625ms) */
    801, /* Max Advertising Interval 500.625ms (801*0.625ms) */
    NULL); /* Set to NULL for undirected advertising */

  const auto DEVICE_NAME = CONFIG_BT_DEVICE_NAME;
  constexpr auto DEVICE_NAME_LEN = sizeof(CONFIG_BT_DEVICE_NAME) - 1;

  constexpr auto RUN_STATUS_LED = DK_LED1;
  constexpr auto CON_STATUS_LED = DK_LED2;

  constexpr auto STACKSIZE = 4096;
  constexpr auto PRIORITY = 7;

  constexpr auto RUN_LED_BLINK_INTERVAL = 1000;
  constexpr auto NOTIFY_INTERVAL = 3000;

  const bt_data ad[] = {
    BT_DATA_BYTES(BT_DATA_FLAGS, (BT_LE_AD_GENERAL | BT_LE_AD_NO_BREDR)),
    BT_DATA(BT_DATA_NAME_COMPLETE, DEVICE_NAME, DEVICE_NAME_LEN),
  };

  const bt_data sd[] = {
    BT_DATA_BYTES(BT_DATA_UUID128_ALL, TP25_SVC_UUID_VAL),
  };

  transceiver_callbacks app_callbacks = {
    .read_command = [](uint8_t *_, const uint8_t _2) { LOG_INF("Received read command request"); },
    .write_command = [](uint8_t *buffer, const uint8_t length) {
      LOG_INF("Received command write request");
      tp25_command_write(buffer, length);
    },
    .read_response = [](uint8_t *_, const uint8_t _2) { LOG_INF("Received read response request"); },
  };

  bt_conn_cb connection_callbacks = {
    .connected = on_connected,
    .disconnected = on_disconnected,
  };

  TP25 *tp25;
}

extern "C"
[[noreturn]] void thermopro_thread() {
  while (true) {
    k_sleep(K_MSEC(NOTIFY_INTERVAL));
    if (tp25) { tp25->receive_timer(); }
  }
}

K_THREAD_DEFINE(thermopro_thread_id, STACKSIZE, thermopro_thread, NULL, NULL, NULL, PRIORITY, 0, 0);

extern "C"
int main() {
  int blink_status = 0;
  tp25 = new TP25{tp25_notify_request};

  LOG_INF("Starting Fake ThermoPro TP25\n");

  auto err = dk_leds_init();
  if (err) {
    LOG_ERR("LEDs init failed (err %d)\n", err);
    return -1;
  }

  err = bt_enable(nullptr);
  if (err) {
    LOG_ERR("Bluetooth init failed (err %d)\n", err);
    return -1;
  }
  bt_conn_cb_register(&connection_callbacks);

  if (!transceiver_init(app_callbacks)) {
    printk("Failed to init transceiver (err:%d)\n", err);
    return -1;
  }

  LOG_INF("Bluetooth initialized\n");

  err = bt_le_adv_start(adv_param, ad, ARRAY_SIZE(ad), sd, ARRAY_SIZE(sd));
  if (err) {
    LOG_ERR("Advertising failed to start (err %d)\n", err);
    return -1;
  }

  LOG_INF("Advertising successfully started\n");
  for (;;) {
    dk_set_led(RUN_STATUS_LED, (++blink_status) % 2);
    k_sleep(K_MSEC(RUN_LED_BLINK_INTERVAL));
  }
}

namespace {
  void on_connected(struct bt_conn *conn, uint8_t err) {
    if (err) {
      printk("Connection failed (err %u)\n", err);
      return;
    }

    printk("Connected\n");

    dk_set_led_on(CON_STATUS_LED);
  }

  void on_disconnected(bt_conn *conn, uint8_t reason) {
    printk("Disconnected (reason %u)\n", reason);

    dk_set_led_off(CON_STATUS_LED);
  }

  void tp25_notify_request(RawNotification response) {
    LOG_HEXDUMP_INF(response.value, 20, "Notification");
    notify_response(response.value, sizeof(response.value));
  }

  void tp25_command_write(const uint8_t *buffer, const uint8_t length) {
    LOG_HEXDUMP_INF(buffer, static_cast<uint32_t>(length > 20? 20: length), "Command");
    if (tp25) {
      tp25->receive_command(buffer, length);
    }
  }
}
```

## src/bcd.h
```c
#pragma once

#include <stdexcept>

constexpr uint16_t decToBcd(const uint16_t value) {
  const uint16_t tenths = value % 10;
  const uint16_t ones = (value / 10) % 10;
  const uint16_t tens = (value / 100) % 10;
  const uint16_t hundreds = (value / 1000) % 10;

  return (hundreds << 12) + (tens << 8) + (ones << 4) + tenths;
}

constexpr bool isDigit(const uint8_t val) {
  return val <= 9;
}

constexpr bool isBcd(const uint16_t value) {
  const auto tenths = value & 0xff;
  const auto ones = (value >> 8) & 0xff;
  const auto tens = (value >> 16) & 0xff;
  const auto hundreds = value >> 24;

  return isDigit(tenths) && isDigit(ones) && isDigit(tens) && isDigit(hundreds);
}

constexpr uint16_t bcdToDec(const uint16_t value) {
  if (!isBcd(value)) {
    return 0xffff;
  }

  const auto tenths = value & 0xff;
  const auto ones = (value >> 8) & 0xff;
  const auto tens = (value >> 16) & 0xff;
  const auto hundreds = value >> 24;

  return tenths + ones * 10 + tens * 100 + hundreds * 1000;
}
```

## src/tp25.c
```c
/*
 * Copyright (c) 2018 Nordic Semiconductor ASA
 *
 * SPDX-License-Identifier: LicenseRef-Nordic-5-Clause
 */

/** @file
 *  @brief LED Button Service (LBS) sample
 */

#include <zephyr/types.h>
#include <stddef.h>
#include <string.h>
#include <errno.h>
#include <zephyr/sys/printk.h>
#include <zephyr/sys/byteorder.h>
#include <zephyr/kernel.h>
#include <zephyr/logging/log.h>
#include <zephyr/bluetooth/bluetooth.h>
#include <zephyr/bluetooth/hci.h>
#include <zephyr/bluetooth/conn.h>
#include <zephyr/bluetooth/uuid.h>
#include <zephyr/bluetooth/gatt.h>

#include "tp25.h"

LOG_MODULE_DECLARE(Lesson4_Exercise2);

static bool notify_mysensor_enabled;
static bool indicate_enabled;
static bool button_state;
static struct my_lbs_cb lbs_cb;

/* STEP 4 - Define an indication parameter */
static struct bt_gatt_indicate_params ind_params;

/* STEP 3 - Implement the configuration change callback function */
static void mylbsbc_ccc_cfg_changed(const struct bt_gatt_attr *attr, uint16_t value)
{
	indicate_enabled = (value == BT_GATT_CCC_INDICATE);
}

/* STEP 13 - Define the configuration change callback function for the MYSENSOR characteristic */
static void mylbsbc_ccc_mysensor_cfg_changed(const struct bt_gatt_attr *attr, uint16_t value)
{
	notify_mysensor_enabled = (value == BT_GATT_CCC_NOTIFY);
}

// This function is called when a remote device has acknowledged the indication at its host layer
static void indicate_cb(struct bt_conn *conn, struct bt_gatt_indicate_params *params, uint8_t err)
{
	LOG_DBG("Indication %s\n", err != 0U ? "fail" : "success");
}
static ssize_t write_led(struct bt_conn *conn, const struct bt_gatt_attr *attr, const void *buf,
			 uint16_t len, uint16_t offset, uint8_t flags)
{
	LOG_DBG("Attribute write, handle: %u, conn: %p", attr->handle, (void *)conn);

	if (len != 1U) {
		LOG_DBG("Write led: Incorrect data length");
		return BT_GATT_ERR(BT_ATT_ERR_INVALID_ATTRIBUTE_LEN);
	}

	if (offset != 0) {
		LOG_DBG("Write led: Incorrect data offset");
		return BT_GATT_ERR(BT_ATT_ERR_INVALID_OFFSET);
	}

	if (lbs_cb.led_cb) {
		// Read the received value
		uint8_t val = *((uint8_t *)buf);

		if (val == 0x00 || val == 0x01) {
			// Call the application callback function to update the LED state
			lbs_cb.led_cb(val ? true : false);
		} else {
			LOG_DBG("Write led: Incorrect value");
			return BT_GATT_ERR(BT_ATT_ERR_VALUE_NOT_ALLOWED);
		}
	}

	return len;
}

static ssize_t read_button(struct bt_conn *conn, const struct bt_gatt_attr *attr, void *buf,
			   uint16_t len, uint16_t offset)
{
	// get a pointer to button_state which is passed in the BT_GATT_CHARACTERISTIC() and stored in attr->user_data
	const char *value = attr->user_data;

	LOG_DBG("Attribute read, handle: %u, conn: %p", attr->handle, (void *)conn);

	if (lbs_cb.button_cb) {
		// Call the application callback function to update the get the current value of the button
		button_state = lbs_cb.button_cb();
		return bt_gatt_attr_read(conn, attr, buf, len, offset, value, sizeof(*value));
	}

	return 0;
}

/* LED Button Service Declaration */
BT_GATT_SERVICE_DEFINE(
	my_lbs_svc, BT_GATT_PRIMARY_SERVICE(BT_UUID_LBS),
	/* STEP 1 - Modify the Button characteristic declaration to support indication */
	BT_GATT_CHARACTERISTIC(BT_UUID_LBS_BUTTON, BT_GATT_CHRC_READ | BT_GATT_CHRC_INDICATE,
			       BT_GATT_PERM_READ, read_button, NULL, &button_state),
	/* STEP 2 - Create and add the Client Characteristic Configuration Descriptor */
	BT_GATT_CCC(mylbsbc_ccc_cfg_changed, BT_GATT_PERM_READ | BT_GATT_PERM_WRITE),

	BT_GATT_CHARACTERISTIC(BT_UUID_LBS_LED, BT_GATT_CHRC_WRITE, BT_GATT_PERM_WRITE, NULL,
			       write_led, NULL),
	/* STEP 12 - Create and add the MYSENSOR characteristic and its CCCD  */
	BT_GATT_CHARACTERISTIC(BT_UUID_LBS_MYSENSOR, BT_GATT_CHRC_NOTIFY, BT_GATT_PERM_NONE, NULL,
			       NULL, NULL),

	BT_GATT_CCC(mylbsbc_ccc_mysensor_cfg_changed, BT_GATT_PERM_READ | BT_GATT_PERM_WRITE),

);
/* A function to register application callbacks for the LED and Button characteristics  */
int my_lbs_init(struct my_lbs_cb *callbacks)
{
	if (callbacks) {
		lbs_cb.led_cb = callbacks->led_cb;
		lbs_cb.button_cb = callbacks->button_cb;
	}

	return 0;
}

/* STEP 5 - Define the function to send indications */
int my_lbs_send_button_state_indicate(bool button_state)
{
	if (!indicate_enabled) {
		return -EACCES;
	}
	ind_params.attr = &my_lbs_svc.attrs[2];
	ind_params.func = indicate_cb; // A remote device has ACKed at its host layer (ATT ACK)
	ind_params.destroy = NULL;
	ind_params.data = &button_state;
	ind_params.len = sizeof(button_state);
	return bt_gatt_indicate(NULL, &ind_params);
}

/* STEP 14 - Define the function to send notifications for the MYSENSOR characteristic */
int my_lbs_send_sensor_notify(uint32_t sensor_value)
{
	if (!notify_mysensor_enabled) {
		return -EACCES;
	}

	return bt_gatt_notify(NULL, &my_lbs_svc.attrs[7], &sensor_value, sizeof(sensor_value));
}
```

## src/tp25.cpp
```c
#include <zephyr/kernel.h>

#include "tp25.h"

#include <stdexcept>

#include "bcd.h"
#include "tp25_internal.h"

TP25::TP25(const NotificationCb notification_cb) : notification_cb(notification_cb) {
}

void TP25::receive_command(const uint8_t *buffer, uint8_t length) {
  switch (static_cast<Command>(buffer[0])) {
    case Command::SETUP:
      printk("Setup command\n");
    // Normally command handlers send their own response
      this->notification_cb(getSetupResponse());
      break;

    case Command::SET_PROFILE:
      printk("Set profile command\n");
      this->set_profile(buffer, length);
      break;

    case Command::REPORT_PROFILE:
      printk("Report profile command\n");
      this->report_profile(buffer, length);
      break;

    case Command::ALT_TEMP_REPORT:
      printk("Alt temp report command - drop\n");
      break;

    case Command::UNKNOWN_A:
      printk("Unknown command (A - 26) \n");
      this->notification_cb(getTwoSixResponse());
      break;

    case Command::ALARM_ACK:
      printk("Alarm ack command - drop\n");
      break;

    case Command::TEMP_REPORT:
      printk("Temp report command - do nothing\n");
      //this->notification_cb(getTempReportResponse(this->probes));
      break;

    case Command::UNKNOWN_B:
      printk("Unknown command (B - 41)\n");
      this->notification_cb(getFourOneResponse());
      break;

    case Command::ERROR:
      printk("Error command - drop\n");
      break;

    default:
      printk("Unknown command\n");
  }
}

void TP25::receive_timer() {
  printk("Received timer\n");
  this->notification_cb(getTempReportResponse(this->probes));
}


void TP25::set_profile(uint8_t const *const buffer, const uint8_t length) {
  if (buffer[0] != static_cast<uint8_t>(Command::SET_PROFILE) || buffer[1] != 6 || length < 8) {
    printk("Invalid set profile command - sizes\n");
    return;
  }

  const uint8_t probe = buffer[2];
  if (probe == 0 || probe > 6) {
    printk("Invalid set profile command - index\n");
    return;
  }

  const uint8_t unknown = buffer[3];
  const uint16_t high_temp_alarm = buffer[4] << 8 | buffer[5];
  const uint16_t low_temp_alarm = buffer[6] << 8 | buffer[7];

  Probe &probe_ref = probes[probe];
  probe_ref.alarm_index = unknown;

  if (isBcd(high_temp_alarm)) {
    probe_ref.high_alarm_value = high_temp_alarm;
    probe_ref.low_alarm_value = isBcd(low_temp_alarm) ? low_temp_alarm : 0x0000;
  } else {
    probe_ref.high_alarm_value = isBcd(high_temp_alarm) ? high_temp_alarm : 0xffff;
    probe_ref.low_alarm_value = isBcd(low_temp_alarm) ? low_temp_alarm : 0xffff;
  }

  this->notification_cb(getSetProfileResponse(probe, unknown));
}

void TP25::report_profile(const uint8_t *const buffer, const uint8_t length) const {
  if (buffer[0] != static_cast<uint8_t>(Command::REPORT_PROFILE) || buffer[1] != 1 || length < 4) {
    return;
  }

  const uint8_t probe = buffer[2];
  if (probe == 0 || probe > 6) {
    return;
  }

  const Probe &probe_ref = probes[probe];
  this->notification_cb(getReportProfileResponse(probe, probe_ref.alarm_index, probe_ref.high_alarm_value,
                                                 probe_ref.low_alarm_value));
}
```

## src/tp25.h
```c
#pragma once

#include <cstdint>

struct RawNotification {
  uint8_t value[20];
};

using NotificationCb = void (*)(RawNotification);

struct Probe {
  /// Temperature in tenths of a degree
  uint16_t temp = 200;

  /// Alarm profile index
  uint8_t alarm_index = 0x00;

  /// Low alarm temp in tenths of degree - stored BCDish
  uint16_t low_alarm_value = 0xffff;

  /// High alarm temp in tenths of degree - stored BCDish
  uint16_t high_alarm_value = 0xffff;
};

enum class Command : uint8_t {
  SETUP = 0x01,
  SET_PROFILE = 0x23,
  REPORT_PROFILE = 0x24,
  ALT_TEMP_REPORT = 0x25,
  UNKNOWN_A = 0x26,
  ALARM_ACK = 0x27,
  TEMP_REPORT = 0x30,
  UNKNOWN_B = 0x41,
  ERROR = 0xe0,
};

class TP25 {
public:
  explicit TP25(NotificationCb notification_cb);

  ~TP25() = default;

  void receive_command(const uint8_t *buffer, uint8_t length);
  void receive_timer();

  //void set_temperature(uint8_t probe_index, uint16_t temperature);

private:
  const NotificationCb notification_cb;

  void set_profile(const uint8_t *buffer, uint8_t length);
  void report_profile(const uint8_t *buffer, uint8_t length) const;

  Probe probes[6];
};
```

## src/tp25_internal.h
```c
#pragma once

#include "tp25.h"

RawNotification getSetupResponse();
RawNotification getSetProfileResponse(uint8_t probe_index, uint8_t unknown);
RawNotification getReportProfileResponse(uint8_t probe_index, uint8_t unknown, uint16_t high_temp_alarm_bcd,
                                         uint16_t low_temp_alarm_bcd);
RawNotification getTwoSixResponse();
RawNotification getTempReportResponse(const Probe *probes);
RawNotification getFourOneResponse();
```

## src/tp25_responses.cpp
```c
#include <cstring>
#include "tp25_internal.h"
#include "bcd.h"

constexpr auto notification = RawNotification{
  {
    0x00, 0x11, 0x22, 0x33, 0x44, 0x55, 0x66, 0x77, 0x88, 0x99, 0xaa, 0xbb, 0xcc, 0xdd, 0xee, 0xff, 0x17, 0x18, 0x19,
    0x20
  }
};

namespace {
  constexpr uint8_t getChecksum(const RawNotification &notification, const uint8_t length) {
    uint8_t checksum = 0;
    for (uint8_t i = 0; i < length; i++) {
      checksum = checksum + notification.value[i];
    }
    return checksum;
  }
}

RawNotification getSetupResponse() {
  RawNotification full_response{notification};
  constexpr uint8_t part_response[] = {0x01, 0x01, 0x0a};
  constexpr uint8_t part_length = sizeof(part_response);
  std::memcpy(&full_response, part_response, part_length);
  full_response.value[part_length] = getChecksum(full_response, part_length);

  return full_response;
}

RawNotification getSetProfileResponse(const uint8_t probe_index, const uint8_t unknown) {
  RawNotification full_response{notification};
  const uint8_t part_response[] = {0x023, 0x02, probe_index, unknown};
  constexpr uint8_t part_length = sizeof(part_response);
  std::memcpy(&full_response, part_response, part_length);
  full_response.value[part_length] = getChecksum(full_response, part_length);

  return full_response;
}

RawNotification getReportProfileResponse(const uint8_t probe_index, const uint8_t unknown,
                                         uint16_t const high_temp_alarm_bcd, const uint16_t low_temp_alarm_bcd) {
  RawNotification full_response{notification};
  const uint8_t part_response[] = {
    0x024, 0x06, probe_index, unknown, static_cast<uint8_t>((high_temp_alarm_bcd & 0xff00) >> 8),
    static_cast<uint8_t>(high_temp_alarm_bcd & 0xff), static_cast<uint8_t>((low_temp_alarm_bcd & 0xff00) >> 8),
    static_cast<uint8_t>(low_temp_alarm_bcd & 0xff)
  };
  constexpr uint8_t part_length = sizeof(part_response);
  std::memcpy(&full_response, part_response, part_length);
  full_response.value[part_length] = getChecksum(full_response, part_length);

  return full_response;
}

RawNotification getTwoSixResponse() {
  RawNotification full_response{notification};
  const uint8_t part_response[] = {0x26, 0x5, 0x0c, 0x0c, 0x5a, 0x03, 0x0f};
  constexpr uint8_t part_length = sizeof(part_response);
  std::memcpy(&full_response, part_response, part_length);
  full_response.value[part_length] = getChecksum(full_response, part_length);

  return full_response;
}

RawNotification getTempReportResponse(const Probe *const probes) {
  RawNotification full_response{notification};
  full_response.value[0] = 0x30; // Code
  full_response.value[1] = 0x0f; // Length
  full_response.value[2] = 0x5a; // Unknown
  full_response.value[3] = 0x0c; // unknown
  full_response.value[4] = 0x00; // Alarms (not implemented)

  for (uint8_t i = 0; i < 4; i++) {
    const uint16_t bcd = decToBcd(probes[i].temp);
    full_response.value[5 + (i * 2)] = bcd >> 8;
    full_response.value[5 + (i * 2) + 1] = static_cast<uint8_t>(bcd);
  }
  full_response.value[13] = 0xff;
  full_response.value[14] = 0xff;
  full_response.value[15] = 0xff;
  full_response.value[16] = 0xff;
  full_response.value[17] = getChecksum(full_response, 17);

  return full_response;
}

RawNotification getFourOneResponse() {
  RawNotification full_response{notification};
  const uint8_t part_response[] = {0x41, 0x02, 0x31, 0x11};
  constexpr uint8_t part_length = sizeof(part_response);
  std::memcpy(&full_response, part_response, part_length);
  full_response.value[part_length] = getChecksum(full_response, part_length);

  return full_response;
}
```

## src/transceiver.cpp
```c
/** @file
 *  @brief TP25 BLE transceiver functions
 */

#include <zephyr/types.h>
#include <cstddef>
#include <cstring>
#include <cerrno>
#include <zephyr/sys/printk.h>
#include <zephyr/sys/byteorder.h>
#include <zephyr/kernel.h>
#include <zephyr/logging/log.h>
#include <zephyr/bluetooth/bluetooth.h>
#include <zephyr/bluetooth/hci.h>
#include <zephyr/bluetooth/conn.h>
#include <zephyr/bluetooth/uuid.h>
#include <zephyr/bluetooth/gatt.h>

#include "transceiver.h"

extern "C" {
#include <common/bt_str.h>
}

LOG_MODULE_DECLARE(TP25_Transceiver, LOG_LEVEL_INF);

namespace {
  transceiver_callbacks callbacks;
  bool notify_response_enabled;
}

/* UUID declarations */
/* 1086fff0-3343-4817-8bb2-b32206336ce8 */

/** @brief ThermoPro service, read-write characteristic for commands */
#define TP25_RW_CHARACTERISTIC_VAL \
  BT_UUID_128_ENCODE(0x1086fff1, 0x3343, 0x4817, 0x8bb2, 0xb32206336ce8)
/** @brief ThermoPro service, read-notify characteristic for responses */
#define TP25_NOTIFY_CHARACTERISTIC_VAL \
  BT_UUID_128_ENCODE(0x1086fff2, 0x3343, 0x4817, 0x8bb2, 0xb32206336ce8)

/** @brief ThermoPro service, read-write characteristic for commands */
#define TP25_RW_CHARACTERISTIC \
  BT_UUID_DECLARE_128(TP25_RW_CHARACTERISTIC_VAL)
/** @brief ThermoPro service, read-notify characteristic for responses */
#define TP25_NOTIFY_CHARACTERISTIC \
  BT_UUID_DECLARE_128(TP25_NOTIFY_CHARACTERISTIC_VAL)

/* Forward declarations */
static ssize_t read_command(struct bt_conn *conn, const struct bt_gatt_attr *attr, void *buf, uint16_t len,
                            uint16_t offset);

static ssize_t write_command(struct bt_conn *conn, const struct bt_gatt_attr *attr, const void *buf, uint16_t len,
                             uint16_t offset, uint8_t flags);

static ssize_t read_response(struct bt_conn *conn, const struct bt_gatt_attr *attr, void *buf, uint16_t len,
                             uint16_t offset);

static void response_ccc_cfg_changed(const struct bt_gatt_attr *attr, uint16_t value);

/* Data storage */
uint8_t command_buffer[20] = {};
uint8_t response_buffer[20] = {};

/* LED Button Service Declaration */
BT_GATT_SERVICE_DEFINE(
  tp25_svc, BT_GATT_PRIMARY_SERVICE(TP25_SVC_UUID),

  BT_GATT_CHARACTERISTIC(TP25_RW_CHARACTERISTIC, BT_GATT_CHRC_READ | BT_GATT_CHRC_WRITE,
    BT_GATT_PERM_READ | BT_GATT_PERM_WRITE, read_command, write_command, command_buffer),

  BT_GATT_CHARACTERISTIC(TP25_NOTIFY_CHARACTERISTIC, BT_GATT_CHRC_READ | BT_GATT_CHRC_NOTIFY, BT_GATT_PERM_READ,
    read_response, nullptr, response_buffer),

  BT_GATT_CCC(response_ccc_cfg_changed, BT_GATT_PERM_READ | BT_GATT_PERM_WRITE),
);

/* Command handlers */
static ssize_t read_command(bt_conn *conn, const bt_gatt_attr *attr, void *buf, const uint16_t len,
                            const uint16_t offset) {
  const auto value = attr->user_data;
  LOG_DBG("Command attribute read, handle: %u, conn: %p", attr->handle, (void *)conn);
  if (callbacks.read_command) {
    callbacks.read_command(static_cast<uint8_t *>(buf) + offset, len);
  }
  return bt_gatt_attr_read(conn, attr, buf, len, offset, value, len);
}

static ssize_t write_command(bt_conn *conn, const bt_gatt_attr *attr, const void *buf, const uint16_t len,
                             const uint16_t offset, uint8_t flags) {
  LOG_DBG("Command attribute write, handle: %u, conn: %p", attr->handle, (void *)conn);

  if (len < 3) {
    LOG_DBG("Write command: command too short.");
    return BT_GATT_ERR(BT_ATT_ERR_INVALID_ATTRIBUTE_LEN);
  }

  if (len > 20) {
    LOG_DBG("Write command: command too long.");
    return BT_GATT_ERR(BT_ATT_ERR_INVALID_ATTRIBUTE_LEN);
  }

  if (offset != 0) {
    LOG_DBG("Write led: Incorrect data offset");
    return BT_GATT_ERR(BT_ATT_ERR_INVALID_OFFSET);
  }

  memcpy(command_buffer, buf, len);

  if (callbacks.write_command) {
    callbacks.write_command(command_buffer, len);
  }

  return len;
}

/* Response handlers */
static ssize_t read_response(bt_conn *conn, const bt_gatt_attr *attr, void *buf, const uint16_t len,
                             const uint16_t offset) {
  const auto value = attr->user_data;
  LOG_DBG("Response attribute read, handle: %u, conn: %p", attr->handle, (void *)conn);
  if (callbacks.read_response) {
    callbacks.read_response(static_cast<uint8_t *>(buf) + offset, len);
  }
  return bt_gatt_attr_read(conn, attr, buf, len, offset, value, len);
}

int notify_response(uint8_t const *const buf, const uint8_t len) {
  if (len > 20) {
    LOG_DBG("Notify response: response too long.");
    return -EINVAL;
  }

  memcpy(response_buffer, buf, len);

  if (!notify_response_enabled) {
    LOG_DBG("Notification dropped - not enabled.");
    return -EACCES;
  }

  // TODO: Remove the magic constant and make sure it always points at the notify chc
  return bt_gatt_notify(nullptr, &tp25_svc.attrs[4], response_buffer, len);;
}

static void response_ccc_cfg_changed(const struct bt_gatt_attr *attr, uint16_t value) {
  notify_response_enabled = (value == BT_GATT_CCC_NOTIFY);
}

/* A function to register application callbacks for the LED and Button characteristics  */
bool transceiver_init(const transceiver_callbacks &callbacks) {
  ::callbacks = callbacks;

  // Dump out attribute table for debugging purposes
  uint16_t i;

  for (i = 0; i < tp25_svc.attr_count; i++) {
    printk("Attribute %d UUID: %s\n", i, bt_uuid_str(tp25_svc.attrs[i].uuid));
  }

  return true;
}
```

## src/transceiver.h
```c
#pragma once

#include <cstdint>

/** @brief ThermoPro service UUID */
#define TP25_SVC_UUID_VAL \
BT_UUID_128_ENCODE(0x1086fff0, 0x3343, 0x4817, 0x8bb2, 0xb32206336ce8)

/** @brief ThermoPro service UUID */
#define TP25_SVC_UUID \
BT_UUID_DECLARE_128(TP25_SVC_UUID_VAL)

using read_command_callback = void (*)(uint8_t *buffer, uint8_t length);
using read_response_callback = void (*)(uint8_t *buffer, uint8_t length);
using write_command_callback = void (*)(uint8_t *buffer, uint8_t length);

struct transceiver_callbacks {
  read_command_callback read_command;
  write_command_callback write_command;
  read_response_callback read_response;
};

bool transceiver_init(const transceiver_callbacks &callbacks);

int notify_response(uint8_t const *const buf, const uint8_t len);
```
